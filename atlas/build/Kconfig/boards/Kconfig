## atlas/build/Kconfig/boards/Kconfig
```kconfig
# Load Zephyr board Kconfig descriptions.
osource "/home/sinis/zephyrproject/zephyr/boards/sinis/atlas/Kconfig"
```

## atlasDebug/build/Kconfig/boards/Kconfig.atlas
```kconfig
# Load board Kconfig descriptions.
osource "/home/sinis/zephyrproject/zephyr/boards/sinis/atlas/Kconfig.atlas"
```

## atlasTagDebug/build/Kconfig/boards/Kconfig.atlas_nrf52833
```kconfig
# Load board Kconfig descriptions.
osource "/home/sinis/zephyrproject/zephyr/boards/sinis/atlas_nrf52833/Kconfig.atlas_nrf52833"
```

## atlasTagDebug/sample.yaml
```yaml
sample:
  name: DWM3000 SPI with USB Console Sample
  description: Test DWM3000 SPI functionality with output over USB CDC-ACM console

tests:
  sample.drivers.spi.usb_console:
    tags:
      - spi
      - usb
    filter: dt_compat_enabled("nordic,nrf-spi") and dt_enabled(DT_CHOSEN(zephyr_udc))
    platform_allow:
      - raytac_mdbt50_db_33/nrf52833
    harness: console
    harness_config:
      type: multi_line
      ordered: true
      regex:
        - "Initializing DWM3000..."
        - "Device ID: 0xDECA0302"
    depends_on:
      - spi
      - usb_device
```

## atlasTagTest/build/Kconfig/boards/Kconfig.sysbuild
```kconfig
# Load Sysbuild board Kconfig descriptions.
osource "/home/sinis/zephyrproject/zephyr/boards/sinis/atlas_nrf52833/Kconfig.sysbuild"
```

## bluetooth/peripheral/build/Kconfig/boards/Kconfig.raytac_mdbt50_db_33
```kconfig
# Load board Kconfig descriptions.
osource "/home/sinis/zephyrproject/zephyr/boards/sinis/mdbt50_db_33/Kconfig.raytac_mdbt50_db_33"
```

## cardSpi/build/Kconfig/boards/Kconfig.defconfig
```kconfig
# Load Zephyr board defconfig descriptions.
osource "/home/sinis/zephyrproject/zephyr/boards/sinis/mdbt50_db_33/Kconfig.defconfig"
```

## result/build/Kconfig/boards/Kconfig.defconfig
```kconfig
# Load Zephyr board defconfig descriptions.
osource "/home/sinis/zephyrproject/zephyr/boards/sinis/atlas/Kconfig.defconfig"
```

## resultCard/build/Kconfig/boards/Kconfig
```kconfig
# Load Zephyr board Kconfig descriptions.
osource "/home/sinis/zephyrproject/zephyr/boards/sinis/mdbt50_db_33/Kconfig"
```

## test/build/Kconfig/arch/Kconfig
```kconfig
# Load Zephyr Arch Kconfig descriptions.
osource "/home/sinis/zephyrproject/zephyr/arch/x86/Kconfig"
osource "/home/sinis/zephyrproject/zephyr/arch/xtensa/Kconfig"
osource "/home/sinis/zephyrproject/zephyr/arch/sparc/Kconfig"
osource "/home/sinis/zephyrproject/zephyr/arch/riscv/Kconfig"
osource "/home/sinis/zephyrproject/zephyr/arch/posix/Kconfig"
osource "/home/sinis/zephyrproject/zephyr/arch/nios2/Kconfig"
osource "/home/sinis/zephyrproject/zephyr/arch/mips/Kconfig"
osource "/home/sinis/zephyrproject/zephyr/arch/arm64/Kconfig"
osource "/home/sinis/zephyrproject/zephyr/arch/arm/Kconfig"
osource "/home/sinis/zephyrproject/zephyr/arch/arc/Kconfig"
```

## test/build/Kconfig/boards/Kconfig.sysbuild
```kconfig
# Load Sysbuild board Kconfig descriptions.
osource "/home/sinis/zephyrproject/zephyr/boards/sinis/mdbt50_db_33/Kconfig.sysbuild"
```
